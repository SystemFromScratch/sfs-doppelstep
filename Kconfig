## apps/dts/bindings/sfs/sfs,stm32-shared-leg-power-stage.yaml
```yaml
# SPDX-License-Identifier: Apache-2.0

description: |
  Three half-bridges driven by an STM32 advanced-control timer (TIM1) with
  complementary outputs, with low-side shunt current sensing through the
  internal OPAMPs and injected ADC conversions triggered by the timer.

  The application programs TIM1, ADC1 and ADC2 directly (LL); the referenced
  timer and ADC nodes must therefore stay "disabled" so that no Zephyr driver
  claims them. The OPAMP nodes are "okay" and configured by the Zephyr OPAMP
  driver.

  Legs, in the order of Stepper-C's shared-leg topology:
    leg 0 = U = TIM1 CH1/CH1N, leg 1 = V = CH2/CH2N, leg 2 = W = CH3/CH3N
  Phase A of the stepper motor is connected between U and W, phase B
  between V and W.

compatible: "sfs,stm32-shared-leg-power-stage"

include: [base.yaml, pinctrl-device.yaml]

properties:
  pinctrl-0:
    required: true

  pinctrl-names:
    required: true

  timer:
    type: phandle
    required: true
    description: Advanced-control timer node (st,stm32-timers), status "disabled".

  adc-master:
    type: phandle
    required: true
    description: |
      ADC that converts phase U current, bus voltage and phase W current and
      raises the end-of-sequence interrupt (status "disabled").

  adc-slave:
    type: phandle
    required: true
    description: ADC that converts phase V current (status "disabled").

  opamps:
    type: phandles
    required: true
    description: Current amplifiers of phases U, V and W.

  opamp-gain:
    type: string
    required: true
    enum: ["OPAMP_GAIN_15", "OPAMP_GAIN_16"]
    description: PGA gain applied with opamp_set_gain() to every OPAMP.

  pwm-frequency:
    type: int
    required: true
    description: PWM frequency [Hz] (center-aligned).

  dead-time-ns:
    type: int
    required: true
    description: |
      Dead time inserted by the timer [ns]. 0 means "not set": the
      application then refuses to enable the outputs.

  phase-u-channel:
    type: int
    required: true
    description: adc-master channel of the phase U current amplifier output.

  phase-v-channel:
    type: int
    required: true
    description: adc-slave channel of the phase V current amplifier output.

  phase-w-channel:
    type: int
    required: true
    description: adc-master channel of the phase W current amplifier output.

  vbus-channel:
    type: int
    required: true
    description: adc-master channel of the bus voltage divider.

  adc-vref-mv:
    type: int
    required: true
    description: ADC reference voltage [mV].

  shunt-micro-ohms:
    type: int
    required: true
    description: Shunt resistance [uOhm].

  current-sense-gain-milli:
    type: int
    required: true
    description: |
      Voltage gain from the shunt to the ADC input, x1000. Negative for an
      inverting amplifier.

  vbus-divider:
    type: array
    required: true
    description: Bus voltage divider <R_low R_high> [Ohm]; V_adc = V_bus * R_low / (R_low + R_high).
```

## apps/modules/sfs-stepper-sim/zephyr/Kconfig
```kconfig
# SPDX-License-Identifier: Apache-2.0
#
# Plant model of sfs-stepper-sim (sil/c/sstep_plant.c) and its parameters.

menuconfig SSTEP_PLANT
	bool "sfs-stepper-sim plant model (power stage + stepper motor)"
	help
	  The C model of the Xcos plant block of sfs-stepper-sim, built in
	  single precision without the switching stage. Its parameters come
	  from params/*.json of the same repository, read at build time into
	  the generated header sstep_plant_params.h.

if SSTEP_PLANT

config SSTEP_PLANT_MOTOR_PARAMS
	string "Motor parameter file (params/<name>.json)"
	default "motor_17hs19_2004s1"
	help
	  Written by tools/export_params.py of sfs-stepper-sim from the
	  params/<name>.sci file of the Scilab model.

config SSTEP_PLANT_STAGE_PARAMS
	string "Power stage parameter file (params/<name>.json)"
	default "stage_esc1_spice"
	help
	  Written by tools/run_tests.py --export of sfs-stepper-power-spice
	  (ngspice): leg resistance, diode drop, effective dead time and the
	  leg voltage error table.

endif # SSTEP_PLANT
```

## apps/modules/stepper-c/zephyr/Kconfig
```kconfig
# SPDX-License-Identifier: Apache-2.0
#
# Stepper-C build-time options (inc/sstep_config.h). Motor, power stage and
# control parameters are run-time values given to sstep_init().

menuconfig SSTEP
	bool "Stepper-C stepper motor control library"
	help
	  Closed-loop microstepping current control for two-phase stepper
	  motors (https://github.com/AntonVynohradov/Stepper-C).

if SSTEP

choice SSTEP_MATH_BACKEND
	prompt "Numeric backend"
	default SSTEP_MATH_FLOAT if FPU
	default SSTEP_MATH_FIXED

config SSTEP_MATH_FIXED
	bool "Fixed point (Q15/Q31, integer only)"

config SSTEP_MATH_FLOAT
	bool "Single-precision float (hardware FPU)"
	depends on FPU
	help
	  The fast loop runs in an interrupt: with threads that also use the
	  FPU enable FPU_SHARING.

endchoice

config SSTEP_TOPOLOGY_FULL_BRIDGE
	bool "Two full H-bridges (4 legs)"
	default y
	help
	  SSTEP_CFG_TOPOLOGY_FULL_BRIDGE.

config SSTEP_TOPOLOGY_SHARED_LEG
	bool "Three half-bridges with a shared leg (3 legs)"
	default y
	help
	  SSTEP_CFG_TOPOLOGY_SHARED_LEG, for example B-G431B-ESC1.

config SSTEP_MICROSTEPS_MAX
	int "Largest microstep division"
	default 256
	range 1 256
	help
	  SSTEP_CFG_MICROSTEPS_MAX, a power of two.

config SSTEP_SINE_TABLE_BITS
	int "log2 of the quarter-wave sine table size"
	default 8
	range 6 10
	help
	  SSTEP_CFG_SINE_TABLE_BITS.

config SSTEP_ARG_CHECKS
	bool "Pointer checks in sstep_fast_loop()"
	default y
	help
	  SSTEP_CFG_ARG_CHECKS. All other functions always check.

endif # SSTEP
```

## boards/st/b_g431b_esc1/Kconfig.b_g431b_esc1
```kconfig
# SPDX-License-Identifier: Apache-2.0
#
# STMicroelectronics B-G431B-ESC1 (STM32G431CBU6, UFQFPN48).

config BOARD_B_G431B_ESC1
	select SOC_STM32G431XX
```

## boards/st/b_g431b_esc1/board.yml
```yaml
board:
  name: b_g431b_esc1
  full_name: B-G431B-ESC1 Discovery kit
  vendor: st
  socs:
    - name: stm32g431xx
```

## drivers/Kconfig
```kconfig
# SPDX-License-Identifier: Apache-2.0

menu "Doppelstep drivers"

rsource "power_stage/Kconfig"
rsource "motor/Kconfig"
rsource "x430/Kconfig"

endmenu
```

## drivers/motor/Kconfig
```kconfig
# SPDX-License-Identifier: Apache-2.0

menuconfig SSTEP_MOTOR
	bool "Stepper motor driver built on Stepper-C"
	default y
	depends on DT_HAS_SFS_SSTEP_MOTOR_ENABLED
	select STEPPER
	select SSTEP
	select POWER_STAGE

if SSTEP_MOTOR

config SSTEP_MOTOR_INIT_PRIORITY
	int "Motor driver init priority"
	default 75
	help
	  After the power stage.

config SSTEP_MOTOR_CHILD_INIT_PRIORITY
	int "Init priority of the stepper and stepper_ctrl child devices"
	default 76
	help
	  After the parent device.

config SSTEP_MOTOR_SELFTEST
	bool "Self-test of the bridge and the motor before the first enable"
	default n if DT_HAS_SFS_SIM_POWER_STAGE_ENABLED && !ARCH_POSIX
	default y
	select SSTEP_SELFTEST
	help
	  At the first enable after start (and after clearing the faults),
	  sstep_selftest() of Stepper-C gives each phase the test current of
	  selftest-current-milliamp at a slowly rising voltage; with three legs the
	  driver also checks that the leg currents add up to 0 (the shunt of the
	  shared leg). A phase without current, a short, a current of the wrong
	  sign, a phase on the wrong legs, a current with all legs low or a broken
	  sensor refuses the enable and latches SSTEP_MOTOR_FAULT_SELFTEST. Off by
	  default for the simulated motor on a board (flash); on for native_sim,
	  where the SIL tests run it against the model.

config SSTEP_MOTOR_SELFTEST_EVERY_ENABLE
	bool "Run the self-test at every enable"
	depends on SSTEP_MOTOR_SELFTEST
	help
	  The rotor moves to the nearest full step of the tested coil (at most
	  one full step) and back, at every enable.

config SSTEP_MOTOR_MCUVIEWER
	bool "Measurement variables and capture buffer for MCUViewer"
	help
	  Only for measurements on the bench; off in every release build.
	  The fast loop publishes the measured phase currents, the commanded
	  phase voltages, their averages and the peak-to-peak current in the
	  global variable `mcuv`, and records them into `mcuv_buf` on request
	  (mcuv.capture_arm = 1). MCUViewer, a debugger or
	  tools/mcuviewer/mcuv.py read them over SWD while the motor runs:
	  current ripple at rest and effective dead time without a current
	  probe (docs/measurements.md). Costs RAM for the buffer and a few
	  tens of CPU cycles per fast-loop period: check `fast loop max`.
	  One motor instance is recorded: the first one to start.

config SSTEP_MOTOR_MCUVIEWER_SAMPLES
	int "Points of the capture buffer"
	depends on SSTEP_MOTOR_MCUVIEWER
	default 1024
	range 16 8192
	help
	  8 bytes per point (phase currents and voltages). 1024 points are
	  51 ms at 20 kHz, or about 1 s with a divider of 20.

config SSTEP_MOTOR_THREAD_CHECK
	bool "Check that every call comes from one thread"
	default y if ASSERT

module = SSTEP_MOTOR
module-str = sstep_motor
source "subsys/logging/Kconfig.template.log_config"

endif # SSTEP_MOTOR
```

## drivers/power_stage/Kconfig
```kconfig
# SPDX-License-Identifier: Apache-2.0

menuconfig POWER_STAGE
	bool "Power stage drivers"
	default y if DT_HAS_SFS_STM32_SHARED_LEG_POWER_STAGE_ENABLED || \
		     DT_HAS_SFS_SIM_POWER_STAGE_ENABLED

if POWER_STAGE

config POWER_STAGE_INIT_PRIORITY
	int "Power stage init priority"
	default 70

config POWER_STAGE_STM32
	bool "STM32 backend (timer, ADC injected conversions, OPAMP)"
	default y
	depends on DT_HAS_SFS_STM32_SHARED_LEG_POWER_STAGE_ENABLED

rsource "Kconfig.sim"

module = POWER_STAGE
module-str = power_stage
source "subsys/logging/Kconfig.template.log_config"

endif # POWER_STAGE
```

## drivers/power_stage/Kconfig.sim
```kconfig
# SPDX-License-Identifier: Apache-2.0

config POWER_STAGE_SIM
	bool "Simulation backend: a motor model behind the power stage"
	default y
	depends on DT_HAS_SFS_SIM_POWER_STAGE_ENABLED
	select SSTEP_PLANT
	help
	  Drives the plant model of Stepper-Lab in place of the hardware:
	  the fast loop receives the phase currents and the bus voltage of the
	  model, and its PWM compare values drive the model. Selected by a
	  sfs,sim-power-stage devicetree node, see docs/simulation.md.

	  Model: sil/c/sstep_plant.c of Stepper-Lab (the code of its Xcos
	  plant block), parameters from its params/*.json (CONFIG_SSTEP_PLANT_*).

if POWER_STAGE_SIM

config POWER_STAGE_SIM_INIT_PRIORITY
	int "Simulation backend init priority"
	default 71
	help
	  After the power stage it takes its timing from (timebase property).

config SFS_SIM_VBUS_MV
	int "Bus voltage of the model [mV]"
	default 24000

config SFS_SIM_LEG_ERROR
	bool "Leg voltage error from ngspice (dead time, diodes, leg resistance)"
	default y
	help
	  Adds the leg_error_table of the stage parameter file to the
	  averaged legs (sfs-stepper-power-spice, measured at its vbus / fs;
	  a warning is logged when the model runs elsewhere). Off: ideal legs.

comment "Overrides of the Stepper-Lab parameters (-1 = value of the parameter file)"

config SFS_SIM_R_MOHM
	int "Phase resistance [mOhm]"
	default -1
	help
	  Change it to test the current loop against a motor that differs
	  from the values the controller is tuned for.

config SFS_SIM_L_UH
	int "Phase inductance [uH]"
	default -1

config SFS_SIM_KT_UNM_PER_A
	int "Torque constant [uN*m/A] (= back-EMF constant [uV*s/rad])"
	default -1

config SFS_SIM_INERTIA_G_MM2
	int "Rotor and load inertia [g*mm^2]"
	default -1
	help
	  17HS19-2004S1 rotor: 82 g*cm^2 = 8200 g*mm^2 (datasheet). Add the
	  inertia of the load, referred to the motor shaft.

config SFS_SIM_VISCOUS_UNM_S
	int "Viscous friction [uN*m*s/rad]"
	default -1

config SFS_SIM_DETENT_UNM
	int "Detent torque amplitude [uN*m]"
	default -1
	help
	  One period per full step. Stepper-Lab test T11 uses 20000
	  (about 3 % of the holding torque).

config SFS_SIM_COULOMB_UNM
	int "Dry (Coulomb) friction [uN*m]"
	default -1

comment "Scenario"

config SFS_SIM_LOAD_UNM
	int "Constant load torque [uN*m], positive against forward motion"
	default 0
	help
	  A constant active torque, like gravity on a joint. It acts from the
	  first time the outputs are enabled (at power-on the joint rests on a
	  support) and stays when the torque is switched off again. Also
	  settable at run time with power_stage_sim_set_load() and on native_sim
	  with -sim_load_unm=<uN*m>.

config SFS_SIM_LOCKED_ROTOR
	bool "Locked rotor (current loop test)"

config SFS_SIM_SUBSTEPS
	int "RK4 steps per PWM period"
	default 1
	range 1 8
	help
	  One step of 50 us at 20 kHz is accurate for the 17HS19-2004S1
	  (electrical time constant 1.9 ms, mechanical resonance about 220 Hz).
	  Every step costs four sinf/cosf pairs in the fast-loop interrupt:
	  check the "fast loop max" figure of the periodic log.

config SFS_SIM_LOG_PERIOD_MS
	int "Period of the model log line [ms], 0 = off"
	default 1000

endif # POWER_STAGE_SIM
```

## drivers/x430/Kconfig
```kconfig
# SPDX-License-Identifier: Apache-2.0

menuconfig X430_SERVO
	bool "Emulated DYNAMIXEL X430 servo on a UART bus"
	default y
	depends on DT_HAS_SFS_X430_SERVO_ENABLED
	select SFS_DYNAMIXEL_X430
	select SERIAL
	select UART_INTERRUPT_DRIVEN
	select UART_USE_RUNTIME_CONFIGURE

if X430_SERVO

config X430_SERVO_INIT_PRIORITY
	int "X430 servo init priority"
	default 80

config SFS_DXL_RX_BUFFER_SIZE
	int "UART receive ring buffer [bytes]"
	default 512

config SFS_DXL_FACTORY_VALUES_MAX
	int "Factory values the application can set (x430_servo_set_factory_value)"
	default 4
	range 0 16
	help
	  Registers whose X430 factory value this firmware replaces, for example
	  the limits of the real motor. Applied at the first start and after
	  every Factory Reset.

config SFS_DXL_POLL_MS
	int "Bus Watchdog poll period [ms]"
	default 10

config SFS_DXL_NVM
	bool "Store the EEPROM area and the Control Table backup in flash (NVS)"
	default y
	depends on NVS
	help
	  Uses the partition of the storage property. Writes are refused while
	  the application says so: an erase of a single-bank flash stalls the CPU
	  and with it the current loop.

config SFS_DXL_REBOOT_RESETS_MCU
	bool "Reboot (0x08) resets the MCU"
	default y if BOOTLOADER_MCUBOOT
	select REBOOT
	help
	  After the status packet, the driver resets the MCU, so MCUboot opens
	  its serial recovery window (docs/firmware-update.md). The position
	  restarts, unlike on an XM430. Off: Reboot stays emulated (native_sim
	  and the SIL tests).

module = X430_SERVO
module-str = x430_servo
source "subsys/logging/Kconfig.template.log_config"

endif # X430_SERVO
```

## dts/bindings/sfs/power-stage-common.yaml
```yaml
# SPDX-License-Identifier: Apache-2.0
#
# Measurement scaling of a low-side shunt power stage, shared by the backends.

properties:
  pwm-frequency:
    type: int
    description: PWM frequency [Hz] (center-aligned).

  adc-vref-mv:
    type: int
    description: ADC reference voltage [mV].

  shunt-micro-ohms:
    type: int
    description: Shunt resistance [uOhm].

  current-sense-gain-milli:
    type: int
    description: |
      Voltage gain from the shunt to the ADC input, x1000. Negative for an
      inverting amplifier.

  vbus-divider:
    type: array
    description: Bus voltage divider <R_low R_high> [Ohm]; V_adc = V_bus * R_low / (R_low + R_high).

  current-sense-invert:
    type: boolean
    description: |
      Invert the measured phase current polarity. The sign of adc_i_span follows
      current-sense-gain-milli. Bring-up step 2 of the Stepper-C integration guide:
      if the measured current of phase A is negative after sstep_enable() in voltage
      drive, set this property.
```
