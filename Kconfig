## dts/bindings/sfs/sfs,sim-power-stage.yaml
```yaml
# SPDX-License-Identifier: Apache-2.0

description: |
  Simulation backend of the power_stage class: the motor model of Stepper-Lab
  takes the place of the hardware. It never switches real outputs.

  Without "timebase" a kernel timer runs the PWM periods and the scaling comes from
  the properties of this node (pwm-frequency, timer-clock-hz, adc-vref-mv,
  shunt-micro-ohms, current-sense-gain-milli, vbus-divider are then required).
  With "timebase" timing and scaling come from that stage.

compatible: "sfs,sim-power-stage"

include: [base.yaml, power-stage-common.yaml]

properties:
  timebase:
    type: phandle
    description: Power stage whose fast-loop interrupt gives the PWM periods.

  timer-clock-hz:
    type: int
    description: PWM timer clock of the simulated stage [Hz].

  microsteps:
    type: int
    required: true
    description: Microsteps per full step of the controller, for the rotor position.

  full-steps-per-rev:
    type: int
    required: true
    description: Full steps per revolution of the controller, checked against the model.
```

## dts/bindings/sfs/sfs,sstep-motor.yaml
```yaml
# SPDX-License-Identifier: Apache-2.0

description: |
  Stepper motor driver built on Stepper-C, with the motor, the limits of the stage
  and the tuning of the control. Its children provide the standard classes:
  sfs,sstep-stepper-driver (stepper) and sfs,sstep-stepper-ctrl (stepper_ctrl).

compatible: "sfs,sstep-motor"

include: base.yaml

properties:
  power-stage:
    type: phandle
    required: true
    description: Power stage that drives the motor; selects the backend.

  phase-resistance-milliohm:
    type: int
    required: true

  phase-inductance-microhenry:
    type: int
    required: true

  rated-current-milliamp:
    type: int
    required: true

  back-emf-uv-s-per-rad:
    type: int
    required: true
    description: Back-EMF constant [uV*s/rad]; 0 = unknown.

  full-steps-per-rev:
    type: int
    required: true

  vbus-nominal-mv:
    type: int
    required: true

  vbus-min-mv:
    type: int
    required: true
    description: Undervoltage trip [mV]; 0 = disabled.

  vbus-max-mv:
    type: int
    required: true
    description: Overvoltage trip [mV]; 0 = disabled.

  trip-current-milliamp:
    type: int
    required: true
    description: Overcurrent trip [mA].

  aux-trip:
    type: boolean
    description: |
      Also check the leg the samples do not show (phase W of the shared leg, which
      carries iA + iB), at the trip current.

  voltage-drive:
    type: boolean
    description: |
      Open-loop voltage drive instead of current drive. Bring-up step 2 of the
      Stepper-C integration guide (current polarity check).

  slow-loop-hz:
    type: int
    required: true
    description: Slow loop rate [Hz]; the PWM frequency must be an integer multiple of it.

  microsteps:
    type: int
    required: true
    description: Microsteps per full step.

  current-bandwidth-hz:
    type: int
    required: true

  run-current-milliamp:
    type: int
    required: true

  hold-current-milliamp:
    type: int
    required: true

  hold-delay-ms:
    type: int
    required: true
    description: Standstill time before the hold current [ms].

  max-velocity:
    type: int
    required: true
    description: Maximum velocity [microsteps/s].

  max-acceleration:
    type: int
    required: true
    description: Maximum acceleration [microsteps/s^2].
```

## dts/bindings/sfs/sfs,sstep-stepper-ctrl.yaml
```yaml
# SPDX-License-Identifier: Apache-2.0

description: Standard class "stepper_ctrl" of a sfs,sstep-motor parent node.

compatible: "sfs,sstep-stepper-ctrl"

include: base.yaml
```

## dts/bindings/sfs/sfs,sstep-stepper-driver.yaml
```yaml
# SPDX-License-Identifier: Apache-2.0

description: Standard class "stepper" of a sfs,sstep-motor parent node.

compatible: "sfs,sstep-stepper-driver"

include: base.yaml
```

## dts/bindings/sfs/sfs,stm32-shared-leg-power-stage.yaml
```yaml
# SPDX-License-Identifier: Apache-2.0

description: |
  Three half-bridges driven by an STM32 advanced-control timer (TIM1) with
  complementary outputs, with low-side shunt current sensing through the
  internal OPAMPs and injected ADC conversions triggered by the timer.

  This backend programs TIM1, ADC1 and ADC2 directly (LL); the referenced
  timer and ADC nodes must therefore stay "disabled" so that no Zephyr driver
  claims them. The OPAMP nodes are "okay" and configured by the Zephyr OPAMP
  driver.

  Legs, in the order of Stepper-C's shared-leg topology:
    leg 0 = U = TIM1 CH1/CH1N, leg 1 = V = CH2/CH2N, leg 2 = W = CH3/CH3N
  Phase A of the stepper motor is connected between U and W, phase B
  between V and W.

compatible: "sfs,stm32-shared-leg-power-stage"

include: [base.yaml, pinctrl-device.yaml, power-stage-common.yaml]

properties:
  pinctrl-0:
    required: true

  pinctrl-names:
    required: true

  timer:
    type: phandle
    required: true
    description: Advanced-control timer node (st,stm32-timers), status "disabled".

  adc-master:
    type: phandle
    required: true
    description: |
      ADC that converts phase U current, bus voltage and phase W current and
      raises the end-of-sequence interrupt (status "disabled").

  adc-slave:
    type: phandle
    required: true
    description: ADC that converts phase V current (status "disabled").

  opamps:
    type: phandles
    required: true
    description: Current amplifiers of phases U, V and W.

  opamp-gain:
    type: string
    required: true
    enum: ["OPAMP_GAIN_15", "OPAMP_GAIN_16"]
    description: PGA gain applied with opamp_set_gain() to every OPAMP.

  pwm-frequency:
    required: true

  dead-time-ns:
    type: int
    required: true
    description: |
      Dead time inserted by the timer [ns]. 0 means "not set": the
      driver then refuses to enable the outputs.

  phase-u-channel:
    type: int
    required: true
    description: adc-master channel of the phase U current amplifier output.

  phase-v-channel:
    type: int
    required: true
    description: adc-slave channel of the phase V current amplifier output.

  phase-w-channel:
    type: int
    required: true
    description: adc-master channel of the phase W current amplifier output.

  vbus-channel:
    type: int
    required: true
    description: adc-master channel of the bus voltage divider.

  temperature-channel:
    type: int
    description: |
      adc-master channel of the NTC divider (power stage temperature); none = no
      sensor, power_stage_get_temperature() then returns -ENOSYS. The divider is
      the NTC from the ADC reference to the input and ntc-bottom-ohm from the
      input to ground. Converted every PWM period, as the fourth injected rank.

  ntc-r25-ohm:
    type: int
    description: NTC resistance at 25 degC [Ohm]. Required with temperature-channel.

  ntc-beta:
    type: int
    description: |
      B constant of the NTC [K], for the range of interest (B25/85 for a trip
      level near 80 degC). Required with temperature-channel.

  ntc-bottom-ohm:
    type: int
    description: Fixed resistor from the ADC input to ground [Ohm]. Required with temperature-channel.

  sample-window-ns:
    type: int
    default: 0
    description: |
      Time around the top of the counter that every leg spends on its low-side
      switch at least [ns], so that the shunt samples see the phase currents and
      no switching edge: dead time, settling of the amplifier, and the sampling
      phases of the injected conversions. Stepper-C keeps every compare value at
      or below the period minus this time and lowers its voltage limit by the
      same fraction (sample_window_ticks). At most a quarter of the period.

  hw-trip-current-milliamp:
    type: int
    description: |
      Short-circuit level of the hardware trip [mA]; none = no hardware trip.
      COMP1, COMP2 and COMP4 compare the non-inverting inputs of OPAMP1..3
      (PA1, PA7, PB0: shunt voltage on the bias of the board) with DAC3 and drive
      the break input BRK of the timer: the outputs go off in hardware, within the
      break filter (about 0.5 us). Catches a current down through a low-side
      switch: shoot-through, a phase shorted to the bus, a phase-to-phase short.
      The level follows the calibrated offset. Set it above trip-current-milliamp
      of the motor node.

  hw-trip-vbus-mv:
    type: int
    description: |
      Bus overvoltage level of the hardware trip [mV]; none = no hardware trip.
      COMP3 compares the bus divider (PA0) with DAC1 channel 1 and drives the
      break input BRK2 of the timer. Set it above vbus-max-mv of the motor node.

  current-offset-min-counts:
    type: int
    description: |
      Lowest acceptable current sensor offset at 0 A [ADC counts]. Outside
      [min, max], power_stage_calibrate() fails with -EIO and the outputs are
      refused: amplifier, shunt or bias network broken. None = no check.

  current-offset-max-counts:
    type: int
    description: Highest acceptable current sensor offset at 0 A [ADC counts].

  adc-vref-mv:
    required: true

  shunt-micro-ohms:
    required: true

  current-sense-gain-milli:
    required: true

  vbus-divider:
    required: true
```

## dts/bindings/sfs/sfs,x430-servo.yaml
```yaml
# SPDX-License-Identifier: Apache-2.0

description: |
  Emulated DYNAMIXEL X430 servo (Protocol 2.0), a child node of its UART. The joint
  properties are read by the application, which maps the registers onto the motor.

compatible: "sfs,x430-servo"

on-bus: uart

include: base.yaml

properties:
  storage:
    type: phandle
    description: Flash partition of the persistent EEPROM area; none = not persistent.

  factory-id:
    type: int
    default: 1
    description: |
      ID while no EEPROM block is stored and after FACTORY_RESET 0xFF. XM430 factory
      ID is 1; OpenMANIPULATOR-X uses 11..15.

  factory-baud-code:
    type: int
    default: 3
    enum: [0, 1, 2, 3, 4, 5, 6, 7]
    description: |
      Baud Rate register value written when no EEPROM block is stored (first start)
      and after FACTORY_RESET. 3 = 1 Mbps, the bus speed of the OpenMANIPULATOR-X
      ros2_control description. A real XM430 leaves the factory at 1 (57600 bps).

  start-position:
    type: int
    default: 2048
    description: |
      Present Position at startup [pulse]. The stepper motor has no encoder: the
      rotor position at power-on is reported as this value (2048 = 0 rad for
      dynamixel_hardware_interface). Power the joint up in that position.

  gear-motor-revs:
    type: int
    default: 1
    description: Gear ratio, motor revolutions ...

  gear-joint-revs:
    type: int
    default: 1
    description: ... per joint revolutions (1/1 = direct drive).
```

## tests/app/joint/testcase.yaml
```yaml
# SPDX-License-Identifier: Apache-2.0

tests:
  doppelstep.app.joint:
    platform_allow: native_sim/native/64
    integration_platforms:
      - native_sim/native/64
    tags: doppelstep
```

## tests/drivers/common/dts/bindings/sfs/sfs,fake-power-stage.yaml
```yaml
# SPDX-License-Identifier: Apache-2.0

description: Fake power stage for driver tests.

compatible: "sfs,fake-power-stage"

include: base.yaml

properties:
  minimal:
    type: boolean
    description: Leave out the optional operations of the class.
```

## tests/drivers/power_stage/testcase.yaml
```yaml
# SPDX-License-Identifier: Apache-2.0

tests:
  doppelstep.drivers.power_stage:
    platform_allow: native_sim/native/64
    integration_platforms:
      - native_sim/native/64
    tags: doppelstep
```

## tests/drivers/sstep_motor/testcase.yaml
```yaml
# SPDX-License-Identifier: Apache-2.0

common:
  platform_allow: native_sim/native/64
  integration_platforms:
    - native_sim/native/64
  tags: doppelstep

tests:
  doppelstep.drivers.sstep_motor: {}
  doppelstep.drivers.sstep_motor.selftest:
    extra_configs:
      - CONFIG_SSTEP_MOTOR_SELFTEST=y
```
