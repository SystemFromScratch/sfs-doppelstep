## CMakeLists.txt
```
# SPDX-License-Identifier: Apache-2.0
#
# Doppelstep: stepper motor controller on B-G431B-ESC1 that answers as a
# DYNAMIXEL XM430-W350 (Protocol 2.0).

cmake_minimum_required(VERSION 3.20.0)

# Zephyr root of the repository (apps/): out-of-tree board (apps/boards/),
# devicetree bindings (apps/dts/bindings/) and the Zephyr module glue of the
# libraries (apps/modules/), shared by every application under apps/.
get_filename_component(SFS_ROOT "${CMAKE_CURRENT_LIST_DIR}/.." ABSOLUTE)

list(APPEND BOARD_ROOT "${SFS_ROOT}")
list(APPEND DTS_ROOT "${SFS_ROOT}")
list(APPEND EXTRA_ZEPHYR_MODULES
  "${SFS_ROOT}/modules/stepper-c"
  "${SFS_ROOT}/modules/dynamixel-x430"
  "${SFS_ROOT}/modules/sfs-stepper-sim"
)

find_package(Zephyr REQUIRED HINTS $ENV{ZEPHYR_BASE})
project(doppelstep LANGUAGES C)

target_sources(app PRIVATE
  src/main.c
  src/motor.c
  src/joint.c
  src/dxl_bus.c
  src/nvm.c
)

# native_sim: no power stage hardware, the simulated motor is always on
if(CONFIG_ARCH_POSIX)
  target_sources(app PRIVATE src/power_stage_native.c)
else()
  target_sources(app PRIVATE src/power_stage.c)
endif()
target_sources_ifdef(CONFIG_SFS_SIM_PLANT app PRIVATE src/sim_plant.c)

target_link_libraries(app PRIVATE sstep x430)
```

## Kconfig
```
# SPDX-License-Identifier: Apache-2.0
#
# Doppelstep application options. Defaults of the motor, power stage
# and control parameters: the 17HS19-2004S1 on B-G431B-ESC1 example of the
# Stepper-C documentation (docs/index.md, docs/configuration.md).

mainmenu "Doppelstep"

menu "Stepper motor (Stepper-C struct sstep_motor_cfg)"

config SFS_MOTOR_R_MOHM
	int "Phase resistance [mOhm]"
	default 1600

config SFS_MOTOR_L_UH
	int "Phase inductance [uH]"
	default 3000

config SFS_MOTOR_I_RATED_MA
	int "Rated phase current [mA]"
	default 2000

config SFS_MOTOR_KE_UV_S_PER_RAD
	int "Back-EMF constant [uV*s/rad], 0 = unknown"
	default 208600

config SFS_MOTOR_FULL_STEPS_PER_REV
	int "Full steps per revolution"
	default 200

endmenu

menu "Power stage limits (Stepper-C struct sstep_stage_cfg)"

comment "Current and voltage scaling are derived from the power-stage devicetree node"

config SFS_STAGE_VBUS_NOMINAL_MV
	int "Nominal bus voltage [mV]"
	default 24000

config SFS_STAGE_VBUS_MIN_MV
	int "Undervoltage trip [mV], 0 = disabled"
	default 10000

config SFS_STAGE_VBUS_MAX_MV
	int "Overvoltage trip [mV], 0 = disabled"
	default 28000

config SFS_STAGE_I_TRIP_MA
	int "Overcurrent trip [mA]"
	default 3500

config SFS_STAGE_CURRENT_SENSE_INVERT
	bool "Invert the measured phase current polarity"
	help
	  The sign of adc_i_span follows the sign of current-sense-gain-milli
	  of the power-stage node. Bring-up step 2 of the Stepper-C integration
	  guide: if the measured current of phase A is negative after
	  sstep_enable() in voltage drive, set this option.

config SFS_STAGE_PHASE_W_TRIP
	bool "Overcurrent trip on the shared leg (phase W shunt)"
	default y
	help
	  The shared leg carries iA + iB, which Stepper-C does not measure.
	  When set, the fast-loop interrupt converts the W shunt too and
	  reports SSTEP_FAULT_EXTERNAL when |iW| exceeds SFS_STAGE_I_TRIP_MA.

config SFS_STAGE_OFFSET_SAMPLES
	int "Samples averaged for the current sensor offsets at startup"
	default 1024
	range 16 65535

endmenu

menu "Control (Stepper-C struct sstep_ctrl_cfg)"

config SFS_CTRL_VOLTAGE_DRIVE
	bool "Open-loop voltage drive (bring-up)"
	help
	  SSTEP_DRIVE_VOLTAGE instead of SSTEP_DRIVE_CURRENT. Bring-up step 2
	  of the Stepper-C integration guide (current polarity check).

config SFS_CTRL_SLOW_LOOP_HZ
	int "Slow loop rate [Hz]"
	default 1000
	help
	  The PWM frequency of the power-stage node must be an integer
	  multiple of this rate.

config SFS_CTRL_MICROSTEPS
	int "Microsteps per full step"
	default 16

config SFS_CTRL_CURRENT_BW_HZ
	int "Current loop bandwidth [Hz]"
	default 1000

config SFS_CTRL_I_RUN_MA
	int "Run current [mA]"
	default 1500

config SFS_CTRL_I_HOLD_MA
	int "Hold current [mA]"
	default 500

config SFS_CTRL_HOLD_DELAY_MS
	int "Standstill time before the hold current [ms]"
	default 500

config SFS_CTRL_V_MAX
	int "Maximum velocity [microsteps/s]"
	default 16000
	help
	  Upper bound for every velocity derived from the DYNAMIXEL Profile
	  Velocity, Velocity Limit and Goal Velocity registers.

config SFS_CTRL_ACCEL_MAX
	int "Maximum acceleration [microsteps/s^2]"
	default 64000
	help
	  Upper bound for every acceleration derived from the DYNAMIXEL
	  Profile Acceleration register.

endmenu

menu "DYNAMIXEL emulation"

config SFS_DXL_ID
	int "Factory ID"
	default 1
	range 0 252
	help
	  ID used while no EEPROM block is stored and after FACTORY_RESET
	  0xFF. XM430 factory ID is 1; OpenMANIPULATOR-X uses 11..15.

config SFS_DXL_FACTORY_BAUD_CODE
	int "Factory Baud Rate code"
	default 3
	range 0 7
	help
	  Baud Rate register value written when no EEPROM block is stored
	  (first start) and after FACTORY_RESET. 3 = 1 Mbps, the bus speed of
	  the OpenMANIPULATOR-X ros2_control description. A real XM430 leaves
	  the factory at 1 (57600 bps).

config SFS_DXL_START_POSITION
	int "Present Position at startup [pulse]"
	default 2048
	help
	  The stepper motor has no encoder: the rotor position at power-on is
	  reported as this value (2048 = 0 rad for dynamixel_hardware_interface).
	  Power the joint up in that position.

config SFS_DXL_GEAR_MOTOR_REVS
	int "Gear ratio: motor revolutions..."
	default 1
	range 1 1000

config SFS_DXL_GEAR_JOINT_REVS
	int "...per joint revolutions"
	default 1
	range 1 1000
	help
	  Motor revolutions per joint revolution =
	  SFS_DXL_GEAR_MOTOR_REVS / SFS_DXL_GEAR_JOINT_REVS (1/1 = direct drive).

config SFS_DXL_RX_BUFFER_SIZE
	int "UART receive ring buffer [bytes]"
	default 512

config SFS_DXL_POLL_MS
	int "Bus Watchdog poll and live register refresh period [ms]"
	default 10

config SFS_DXL_NVM
	bool "Store the EEPROM area and the Control Table backup in flash (NVS)"
	default y
	depends on NVS
	help
	  Uses the storage_partition. Writes are refused while the power stage
	  is enabled: an erase of the single-bank flash stalls the CPU and with
	  it the current loop.

endmenu

menu "Simulated motor (development without a motor)"

config SFS_SIM_PLANT
	bool "Drive a motor model instead of the power stage" if !ARCH_POSIX
	default y if ARCH_POSIX
	select SSTEP_PLANT
	help
	  Always on for native_sim (power_stage_native.c), which has no power
	  stage hardware.

	  On B-G431B-ESC1: TIM1 and the ADCs run as usual and keep the
	  timing of the fast-loop interrupt, but Stepper-C receives the phase
	  currents and the bus voltage of a motor model instead of the ADC
	  readings, and its PWM compare values drive the model. The gate
	  drivers are never enabled (MOE stays 0): the board runs with or
	  without a motor and bus voltage, and dead-time-ns does not have to
	  be set. Present Current and Present Input Voltage of the DYNAMIXEL
	  Control Table come from the model.

	  Model: sil/c/sstep_plant.c of sfs-stepper-sim (the code of its Xcos
	  plant block), parameters from its params/*.json (CONFIG_SSTEP_PLANT_*);
	  see docs/simulation.md.

if SFS_SIM_PLANT

config SFS_SIM_VBUS_MV
	int "Bus voltage of the model [mV]"
	default SFS_STAGE_VBUS_NOMINAL_MV

config SFS_SIM_LEG_ERROR
	bool "Leg voltage error from ngspice (dead time, diodes, leg resistance)"
	default y
	help
	  Adds the leg_error_table of the stage parameter file to the
	  averaged legs (sfs-stepper-power-spice, measured at its vbus / fs;
	  a warning is logged when the model runs elsewhere). Off: ideal legs.

comment "Overrides of the sfs-stepper-sim parameters (-1 = value of the parameter file)"

config SFS_SIM_R_MOHM
	int "Phase resistance [mOhm]"
	default -1
	help
	  Change it to test the current loop against a motor that differs
	  from the values the controller is tuned for (CONFIG_SFS_MOTOR_*).

config SFS_SIM_L_UH
	int "Phase inductance [uH]"
	default -1

config SFS_SIM_KT_UNM_PER_A
	int "Torque constant [uN*m/A] (= back-EMF constant [uV*s/rad])"
	default -1

config SFS_SIM_INERTIA_G_MM2
	int "Rotor and load inertia [g*mm^2]"
	default -1
	help
	  17HS19-2004S1 rotor: 82 g*cm^2 = 8200 g*mm^2 (datasheet). Add the
	  inertia of the load, referred to the motor shaft.

config SFS_SIM_VISCOUS_UNM_S
	int "Viscous friction [uN*m*s/rad]"
	default -1

config SFS_SIM_DETENT_UNM
	int "Detent torque amplitude [uN*m]"
	default -1
	help
	  One period per full step. sfs-stepper-sim test T11 uses 20000
	  (about 3 % of the holding torque).

config SFS_SIM_COULOMB_UNM
	int "Dry (Coulomb) friction [uN*m]"
	default -1

comment "Scenario"

config SFS_SIM_LOAD_UNM
	int "Constant load torque [uN*m], positive against forward motion"
	default 0
	help
	  A constant active torque, like gravity on a joint. It acts from the
	  first time the outputs are enabled (at power-on the joint rests on a
	  support) and stays when the torque is switched off again. Also
	  settable at run time with sim_plant_set_load() (for example from the
	  debugger) and on native_sim with -sim_load_unm=<uN*m>.

config SFS_SIM_LOCKED_ROTOR
	bool "Locked rotor (current loop test)"

config SFS_SIM_SUBSTEPS
	int "RK4 steps per PWM period"
	default 1
	range 1 8
	help
	  One step of 50 us at 20 kHz is accurate for the 17HS19-2004S1
	  (electrical time constant 1.9 ms, mechanical resonance about 220 Hz).
	  Every step costs four sinf/cosf pairs in the fast-loop interrupt:
	  check the "fast loop max" figure of the periodic log.

config SFS_SIM_LOG_PERIOD_MS
	int "Period of the model log line [ms], 0 = off"
	default 1000

endif # SFS_SIM_PLANT

endmenu

menu "Threads"

config SFS_MOTOR_THREAD_PRIORITY
	int "Slow loop thread priority"
	default -2
	help
	  Cooperative (negative) so that the slow loop is never preempted by
	  another thread.

config SFS_MOTOR_THREAD_STACK_SIZE
	int "Slow loop thread stack size"
	default 1536

config SFS_DXL_THREAD_PRIORITY
	int "DYNAMIXEL bus thread priority"
	default 2

config SFS_DXL_THREAD_STACK_SIZE
	int "DYNAMIXEL bus thread stack size"
	default 2560

endmenu

module = SFS
module-str = doppelstep
source "subsys/logging/Kconfig.template.log_config"

source "Kconfig.zephyr"
```

## prj.conf
```kconfig
# SPDX-License-Identifier: Apache-2.0
#
# Doppelstep application configuration, common to every board. Board-specific
# options: boards/<board>.conf (merged by Zephyr automatically).

# --- Libraries (Zephyr module glue in apps/modules) --------------------------
CONFIG_SSTEP=y
CONFIG_SSTEP_MATH_FLOAT=y
CONFIG_SSTEP_TOPOLOGY_FULL_BRIDGE=n
CONFIG_SSTEP_TOPOLOGY_SHARED_LEG=y

CONFIG_SFS_DYNAMIXEL_X430=y
CONFIG_X430_MODEL_XM430_W350=y
CONFIG_X430_MAX_DEVICES=1
CONFIG_X430_SIMULATOR=n

# --- STATUS LED --------------------------------------------------------------
CONFIG_GPIO=y

# --- DYNAMIXEL bus -----------------------------------------------------------
CONFIG_SERIAL=y
CONFIG_UART_INTERRUPT_DRIVEN=y
CONFIG_UART_USE_RUNTIME_CONFIGURE=y

# --- Persistent EEPROM area of the emulated DYNAMIXEL ------------------------
CONFIG_FLASH=y
CONFIG_FLASH_MAP=y
CONFIG_NVS=y

# --- Logging -----------------------------------------------------------------
CONFIG_LOG=y

# --- Debugging: thread awareness for OpenOCD / J-Link / gdb ------------------
CONFIG_DEBUG_THREAD_INFO=y
CONFIG_THREAD_NAME=y

CONFIG_MAIN_STACK_SIZE=2048
```

## sim.conf
```kconfig
# SPDX-License-Identifier: Apache-2.0
#
# Simulated motor: Stepper-C drives a motor model in the fast-loop interrupt,
# the gate drivers stay off. Build with
#   west build -b b_g431b_esc1 apps/doppelstep -- -DEXTRA_CONF_FILE=sim.conf
# (see "Simulated motor" in the README).

CONFIG_SFS_SIM_PLANT=y
```

## boards/b_g431b_esc1.conf
```kconfig
# SPDX-License-Identifier: Apache-2.0
#
# Doppelstep on B-G431B-ESC1 (merged with prj.conf).

# --- Cortex-M4F: FPU in threads and in the fast-loop interrupt ---------------
CONFIG_FPU=y
CONFIG_FPU_SHARING=y

# Fast loop (ADC end of sequence) above the kernel's interrupt locking
CONFIG_ZERO_LATENCY_IRQS=y

# --- Peripherals -------------------------------------------------------------
CONFIG_OPAMP=y

# NVS erases and writes the internal flash
CONFIG_MPU_ALLOW_FLASH_WRITE=y

# --- Console and logging over RTT (USART2 is the DYNAMIXEL bus) --------------
CONFIG_UART_CONSOLE=n
CONFIG_USE_SEGGER_RTT=y
CONFIG_RTT_CONSOLE=y
CONFIG_LOG_BACKEND_RTT=y
CONFIG_LOG_BACKEND_UART=n
```

## boards/native_sim_native_64.conf
```kconfig
# SPDX-License-Identifier: Apache-2.0
#
# Doppelstep on native_sim/native/64: the firmware as a Linux program, the
# simulated motor behind power_stage_native.c (always on), the DYNAMIXEL bus
# on a pseudoterminal (uart1). Merged with prj.conf.

# 1 ms tick = slow-loop period; power_stage_native.c runs the 20 fast-loop
# periods (20 kHz PWM of the ESC1) of each tick in one timer expiry
CONFIG_SYS_CLOCK_TICKS_PER_SEC=1000

# Logs on stdout of the program
CONFIG_LOG_BACKEND_NATIVE_POSIX=y
CONFIG_LOG_MODE_IMMEDIATE=y
```

## boards/native_sim_native_64.overlay
```dts
/*
 * SPDX-License-Identifier: Apache-2.0
 *
 * Doppelstep on native_sim/native/64: DYNAMIXEL bus on the second PTY UART.
 * The program prints "uart_1 connected to pseudotty: /dev/pts/N" at start;
 * tools/sim/run_native.py links it to a fixed path (see the README).
 */

/ {
	chosen {
		sfs,dxl-uart = &uart1;
	};
};

&uart1 {
	status = "okay";
	current-speed = <1000000>;
};
```

## src/dxl_bus.c
```c
/*
 * SPDX-License-Identifier: Apache-2.0
 *
 * DYNAMIXEL Protocol 2.0 bus with one emulated XM430-W350 (see dxl_bus.h).
 *
 * Threads and contexts (X430 integration guide, "RTOS" layout):
 *   UART ISR        bytes -> ring buffer, wakes the bus thread
 *   bus thread      x430_bus_receive() (parser, answers, hooks; bus lock held
 *                   inside), x430_bus_poll() (Bus Watchdog) and the refresh of
 *                   the live registers every CONFIG_SFS_DXL_POLL_MS
 *   hooks           run in the bus thread; motion commands go to the slow-loop
 *                   thread through motor_*() (synchronous, < 2 slow-loop periods)
 */

#include "dxl_bus.h"

#include <errno.h>
#include <stdlib.h>

#include <zephyr/device.h>
#include <zephyr/devicetree.h>
#include <zephyr/drivers/uart.h>
#include <zephyr/kernel.h>
#include <zephyr/logging/log.h>
#include <zephyr/sys/ring_buffer.h>

#include <x430.h>

#include "joint.h"
#include "motor.h"
#include "nvm.h"

LOG_MODULE_REGISTER(dxl_bus, CONFIG_SFS_LOG_LEVEL);

#define DXL_UART_NODE DT_CHOSEN(sfs_dxl_uart)

#if !DT_NODE_EXISTS(DXL_UART_NODE)
#error "Set /chosen/sfs,dxl-uart to the UART of the DYNAMIXEL bus"
#endif

static const struct device *const uart = DEVICE_DT_GET(DXL_UART_NODE);

/* Baud Rate (8) codes of the X430 Control Table (ROBOTIS e-Manual) */
static const uint32_t baud_bps[] = {9600U,    57600U,   115200U,  1000000U,
				    2000000U, 3000000U, 4000000U, 4500000U};

RING_BUF_DECLARE(rx_ring, CONFIG_SFS_DXL_RX_BUFFER_SIZE);
static K_SEM_DEFINE(rx_sem, 0, 1);
static atomic_t rx_overruns;

K_MUTEX_DEFINE(bus_mutex); /* Zephyr mutexes are recursive */

static struct x430_bus bus;
static struct x430_device joint_dev;

static const struct joint_cfg jcfg = {
	.full_steps_per_rev = CONFIG_SFS_MOTOR_FULL_STEPS_PER_REV,
	.microsteps = CONFIG_SFS_CTRL_MICROSTEPS,
	.gear_motor_revs = CONFIG_SFS_DXL_GEAR_MOTOR_REVS,
	.gear_joint_revs = CONFIG_SFS_DXL_GEAR_JOINT_REVS,
	.start_position = CONFIG_SFS_DXL_START_POSITION,
};

/* Control Table values the mapping needs, kept current by the write hook. */
static struct {
	struct joint_regs regs;
	uint8_t operating_mode;
	uint8_t baud;
	uint32_t profile_velocity;
	uint32_t profile_acceleration;
	uint32_t velocity_limit;
} cache;

static bool eeprom_missing;       /* no EEPROM block at startup */
static bool factory_baud_pending; /* apply CONFIG_SFS_DXL_FACTORY_BAUD_CODE */
static uint16_t faults_reported;

static K_THREAD_STACK_DEFINE(dxl_stack, CONFIG_SFS_DXL_THREAD_STACK_SIZE);
static struct k_thread dxl_thread;

/* ------------------------------------------------------------------------ */
/* UART                                                                     */

static void uart_isr(const struct device *dev, void *user_data)
{
	ARG_UNUSED(user_data);

	uart_irq_update(dev);
	while (uart_irq_rx_ready(dev) != 0) {
		uint8_t buf[16];
		const int n = uart_fifo_read(dev, buf, sizeof(buf));

		if (n <= 0) {
			break;
		}
		if (ring_buf_put(&rx_ring, buf, (uint32_t)n) != (uint32_t)n) {
			(void)atomic_inc(&rx_overruns);
		}
		k_sem_give(&rx_sem);
	}
}

static int uart_write(void *context, const uint8_t *data, size_t length)
{
	ARG_UNUSED(context);
	for (size_t i = 0; i < length; i++) {
		uart_poll_out(uart, data[i]);
	}
	return 0;
}

static int uart_set_baud(uint8_t code)
{
	struct uart_config cfg;
	int ret;

	if (code >= ARRAY_SIZE(baud_bps)) {
		return -EINVAL;
	}
	ret = uart_config_get(uart, &cfg);
	if (ret == -ENOSYS) {
		/* no line rate (native_sim pseudoterminal) */
		LOG_INF("bus at %u bps (not settable)", baud_bps[code]);
		return 0;
	}
	if ((ret == 0) && (cfg.baudrate != baud_bps[code])) {
		cfg.baudrate = baud_bps[code];
		ret = uart_configure(uart, &cfg);
	}
	if (ret != 0) {
		LOG_ERR("UART %u bps: %d", baud_bps[code], ret);
	} else {
		LOG_INF("bus at %u bps", baud_bps[code]);
	}
	return ret;
}

/* ------------------------------------------------------------------------ */
/* X430 port                                                                */

static void port_lock(void *context)
{
	(void)k_mutex_lock(context, K_FOREVER);
}

static void port_unlock(void *context)
{
	(void)k_mutex_unlock(context);
}

static uint32_t port_millis(void *context)
{
	ARG_UNUSED(context);
	return k_uptime_get_32();
}

static void port_delay_us(void *context, uint32_t us)
{
	ARG_UNUSED(context);
	k_busy_wait(us);
}

static const struct x430_port port = {
	.context = &bus_mutex,
	.lock = port_lock,
	.unlock = port_unlock,
	.millis = port_millis,
	.delay_us = port_delay_us,
};

/* ------------------------------------------------------------------------ */
/* Control Table <-> motor                                                  */

static int32_t reg(uint16_t address)
{
	return x430_device_get(&joint_dev, address);
}

static void reload_cache(void)
{
	cache.regs.drive_mode = (uint8_t)reg(X430_ADDR_DRIVE_MODE);
	cache.regs.homing_offset = reg(X430_ADDR_HOMING_OFFSET);
	cache.operating_mode = (uint8_t)reg(X430_ADDR_OPERATING_MODE);
	cache.baud = (uint8_t)reg(X430_ADDR_BAUD_RATE);
	cache.profile_velocity = (uint32_t)reg(X430_ADDR_PROFILE_VELOCITY);
	cache.profile_acceleration = (uint32_t)reg(X430_ADDR_PROFILE_ACCELERATION);
	cache.velocity_limit = (uint32_t)reg(X430_ADDR_VELOCITY_LIMIT);
}

static uint8_t hardware_error_bits(uint16_t faults)
{
	uint8_t bits = 0U;

	if ((faults & (SSTEP_FAULT_OVERVOLTAGE | SSTEP_FAULT_UNDERVOLTAGE)) != 0U) {
		bits |= X430_HW_ERROR_INPUT_VOLTAGE;
	}
	if ((faults & (SSTEP_FAULT_OVERCURRENT | SSTEP_FAULT_EXTERNAL | SSTEP_FAULT_HAL)) != 0U) {
		bits |= X430_HW_ERROR_ELECTRICAL_SHOCK;
	}
	return bits;
}

/* Live registers from the motor snapshot. Bus lock held. */
static void refresh_live(void)
{
	struct motor_snapshot snap;
	const struct sstep_status *st = &snap.status;

	motor_get_snapshot(&snap);

	const int32_t position = joint_position_to_dxl(&jcfg, &cache.regs, st->position);
	const int32_t velocity = joint_velocity_to_dxl(&jcfg, &cache.regs, st->velocity);
	const bool moving = st->state == SSTEP_STATE_MOVING;
	uint8_t moving_status = 0U;

	(void)x430_device_set(&joint_dev, X430_ADDR_PRESENT_POSITION, position);
	(void)x430_device_set(&joint_dev, X430_ADDR_POSITION_TRAJECTORY, position);
	(void)x430_device_set(&joint_dev, X430_ADDR_PRESENT_VELOCITY, velocity);
	(void)x430_device_set(&joint_dev, X430_ADDR_VELOCITY_TRAJECTORY, velocity);
	(void)x430_device_set(&joint_dev, X430_ADDR_PRESENT_CURRENT,
			      joint_current_to_dxl((int32_t)snap.i_amplitude_ma));
	(void)x430_device_set(&joint_dev, X430_ADDR_PRESENT_INPUT_VOLTAGE,
			      (int32_t)((st->vbus_mv + 50U) / 100U));
	(void)x430_device_set(&joint_dev, X430_ADDR_MOVING, moving ? 1 : 0);

	if (moving) {
		moving_status |= X430_MOVING_STATUS_PROFILE_ONGOING |
				 X430_MOVING_STATUS_PROFILE_TRAPEZOIDAL;
	} else if (st->position == st->target) {
		moving_status |= X430_MOVING_STATUS_IN_POSITION;
	}
	(void)x430_device_set(&joint_dev, X430_ADDR_MOVING_STATUS, moving_status);

	/* Faults of the power stage -> Hardware Error Status (once per new fault) */
	const uint16_t fresh = st->faults & (uint16_t)~faults_reported;

	if (fresh != 0U) {
		const uint8_t bits = hardware_error_bits(fresh);

		if (bits != 0U) {
			x430_device_raise_hardware_error(&joint_dev, bits);
		}
	}
	faults_reported = st->faults;

	/* Outputs off while Torque Enable says on (fault, external disable) */
	if ((reg(X430_ADDR_TORQUE_ENABLE) != 0) &&
	    ((st->state == SSTEP_STATE_DISABLED) || (st->state == SSTEP_STATE_FAULT))) {
		(void)x430_device_set(&joint_dev, X430_ADDR_TORQUE_ENABLE, 0);
	}
}

static uint8_t to_status(int rc)
{
	return (rc == 0) ? DXL2_ERR_NONE : DXL2_ERR_RESULT_FAIL;
}

static uint8_t goal_position(int32_t value)
{
	struct motor_snapshot snap;
	struct joint_profile profile;
	int32_t target;

	if (((cache.operating_mode != X430_MODE_POSITION) &&
	     (cache.operating_mode != X430_MODE_EXTENDED_POSITION)) ||
	    (reg(X430_ADDR_TORQUE_ENABLE) == 0)) {
		return DXL2_ERR_NONE; /* stored only, as on an X430 */
	}

	motor_get_snapshot(&snap);
	target = joint_position_from_dxl(&jcfg, &cache.regs, value);
	profile = joint_profile(&jcfg, &cache.regs,
				(uint32_t)llabs((int64_t)target - snap.status.position),
				cache.profile_velocity, cache.profile_acceleration,
				cache.velocity_limit, CONFIG_SFS_CTRL_V_MAX,
				CONFIG_SFS_CTRL_ACCEL_MAX);

	return to_status(motor_move_to(target, profile.v_max, profile.accel));
}

static uint8_t goal_velocity(int32_t value)
{
	uint32_t cap = CONFIG_SFS_CTRL_V_MAX;
	uint32_t accel = CONFIG_SFS_CTRL_ACCEL_MAX;
	int32_t velocity;

	if ((cache.operating_mode != X430_MODE_VELOCITY) || (reg(X430_ADDR_TORQUE_ENABLE) == 0)) {
		return DXL2_ERR_NONE;
	}

	if (cache.velocity_limit > 0U) {
		cap = MIN(cap, joint_speed_from_dxl(&jcfg, cache.velocity_limit));
	}
	if (cache.profile_acceleration > 0U) {
		accel = CLAMP(joint_accel_from_dxl(&jcfg, cache.profile_acceleration), 1U,
			      (uint32_t)CONFIG_SFS_CTRL_ACCEL_MAX);
	}
	velocity = CLAMP(joint_velocity_from_dxl(&jcfg, &cache.regs, value), -(int32_t)cap,
			 (int32_t)cap);

	return to_status(motor_run(velocity, MAX((uint32_t)abs(velocity), 1U), accel));
}

/* ------------------------------------------------------------------------ */
/* X430 hooks (bus thread, bus lock held)                                   */

static uint8_t hook_write(struct x430_device *device, uint16_t address, uint8_t size,
			  int32_t value, void *user_data)
{
	ARG_UNUSED(device);
	ARG_UNUSED(size);
	ARG_UNUSED(user_data);

	switch (address) {
	case X430_ADDR_TORQUE_ENABLE:
		if (value != 0) {
			/* The library copies Present Position into Goal Position next */
			refresh_live();
			return to_status(motor_enable(true));
		}
		return to_status(motor_enable(false));

	case X430_ADDR_OPERATING_MODE:
		/* Position, extended position and velocity map onto Stepper-C;
		 * current, current-based position and PWM need a torque path.
		 */
		if ((value != X430_MODE_POSITION) && (value != X430_MODE_EXTENDED_POSITION) &&
		    (value != X430_MODE_VELOCITY)) {
			return DXL2_ERR_DATA_RANGE;
		}
		cache.operating_mode = (uint8_t)value;
		return DXL2_ERR_NONE;

	case X430_ADDR_DRIVE_MODE:
		cache.regs.drive_mode = (uint8_t)value;
		return DXL2_ERR_NONE;

	case X430_ADDR_HOMING_OFFSET:
		cache.regs.homing_offset = value;
		return DXL2_ERR_NONE;

	case X430_ADDR_BAUD_RATE:
		if ((uint32_t)value >= ARRAY_SIZE(baud_bps)) {
			return DXL2_ERR_DATA_RANGE;
		}
		cache.baud = (uint8_t)value;
		return DXL2_ERR_NONE;

	case X430_ADDR_PROFILE_VELOCITY:
		cache.profile_velocity = (uint32_t)value;
		return DXL2_ERR_NONE;

	case X430_ADDR_PROFILE_ACCELERATION:
		cache.profile_acceleration = (uint32_t)value;
		return DXL2_ERR_NONE;

	case X430_ADDR_VELOCITY_LIMIT:
		cache.velocity_limit = (uint32_t)value;
		return DXL2_ERR_NONE;

	case X430_ADDR_CURRENT_LIMIT:
		return to_status(motor_set_current(joint_current_from_dxl((uint32_t)value),
						   CONFIG_SFS_CTRL_I_HOLD_MA));

	case X430_ADDR_GOAL_POSITION:
		return goal_position(value);

	case X430_ADDR_GOAL_VELOCITY:
		return goal_velocity(value);

	default:
		return DXL2_ERR_NONE;
	}
}

static void hook_read(struct x430_device *device, uint16_t address, uint16_t length,
		      void *user_data)
{
	ARG_UNUSED(device);
	ARG_UNUSED(user_data);

	if ((address + length) > X430_ADDR_REALTIME_TICK) {
		refresh_live();
	}
}

static uint8_t hook_event(struct x430_device *device, enum x430_event event, void *user_data)
{
	ARG_UNUSED(device);
	ARG_UNUSED(user_data);

	switch (event) {
	case X430_EVENT_REBOOT:
		(void)motor_enable(false);
		(void)motor_clear_faults();
		faults_reported = 0U;
		reload_cache();
		break;

	case X430_EVENT_FACTORY_RESET: {
		const uint8_t previous_baud = cache.baud;

		(void)motor_enable(false);
		(void)motor_clear_faults();
		faults_reported = 0U;
		reload_cache();
		/* Baud Rate went back to the X430 factory value: use this
		 * firmware's factory value instead (bus thread, after the answer).
		 */
		if ((cache.baud != previous_baud) &&
		    (cache.baud != CONFIG_SFS_DXL_FACTORY_BAUD_CODE)) {
			factory_baud_pending = true;
		}
		break;
	}

	case X430_EVENT_CLEAR_MULTI_TURN: {
		struct motor_snapshot snap;

		motor_get_snapshot(&snap);
		const int32_t present = joint_position_to_dxl(&jcfg, &cache.regs,
							      snap.status.position);
		const int32_t wrapped = ((present % JOINT_DXL_PULSES_PER_REV) +
					 JOINT_DXL_PULSES_PER_REV) %
					JOINT_DXL_PULSES_PER_REV;

		return to_status(
			motor_set_position(joint_position_from_dxl(&jcfg, &cache.regs, wrapped)));
	}

	case X430_EVENT_BUS_WATCHDOG:
		(void)motor_stop();
		break;

	case X430_EVENT_BAUD_RATE:
		cache.baud = (uint8_t)reg(X430_ADDR_BAUD_RATE);
		(void)uart_set_baud(cache.baud);
		break;

	case X430_EVENT_TORQUE_SHUTDOWN:
		(void)motor_enable(false);
		break;

	case X430_EVENT_BACKUP_RESTORED:
		reload_cache();
		(void)motor_set_current(
			joint_current_from_dxl((uint32_t)reg(X430_ADDR_CURRENT_LIMIT)),
			CONFIG_SFS_CTRL_I_HOLD_MA);
		break;

	default:
		break;
	}
	return DXL2_ERR_NONE;
}

static int hook_nvm_load(struct x430_device *device, enum x430_nvm_slot slot, uint8_t *data,
			 uint16_t size, void *user_data)
{
	const int ret = nvm_load((uint8_t)slot, data, size);

	ARG_UNUSED(device);
	ARG_UNUSED(user_data);
	if ((ret != 0) && (slot == X430_NVM_EEPROM)) {
		eeprom_missing = true;
	}
	return ret;
}

static int hook_nvm_store(struct x430_device *device, enum x430_nvm_slot slot,
			  const uint8_t *data, uint16_t size, void *user_data)
{
	struct motor_snapshot snap;

	ARG_UNUSED(device);
	ARG_UNUSED(user_data);

	/* A flash erase stalls the CPU (single bank) and with it the current loop */
	motor_get_snapshot(&snap);
	if (snap.status.state != SSTEP_STATE_DISABLED) {
		LOG_WRN("NVM write refused: power stage enabled");
		return -EBUSY;
	}
	return nvm_store((uint8_t)slot, data, size);
}

static const struct x430_hooks hooks = {
	.write = hook_write,
	.read = hook_read,
	.event = hook_event,
	.nvm_load = hook_nvm_load,
	.nvm_store = hook_nvm_store,
};

/* Write this firmware's factory Baud Rate through the normal write path
 * (validated, stored in the EEPROM block, X430_EVENT_BAUD_RATE). Bus lock held.
 */
static void apply_factory_baud(void)
{
	const uint8_t code = CONFIG_SFS_DXL_FACTORY_BAUD_CODE;
	const uint8_t rc = x430_device_write(&joint_dev, X430_ADDR_BAUD_RATE, 1U, &code, 0U);

	if (rc != DXL2_ERR_NONE) {
		LOG_ERR("factory Baud Rate %u: error 0x%02x", code, rc);
	}
	x430_device_flush_events(&joint_dev);
}

/* ------------------------------------------------------------------------ */

static void dxl_thread_fn(void *p1, void *p2, void *p3)
{
	int64_t next_poll = k_uptime_get() + CONFIG_SFS_DXL_POLL_MS;

	ARG_UNUSED(p1);
	ARG_UNUSED(p2);
	ARG_UNUSED(p3);

	for (;;) {
		uint8_t chunk[64];
		uint32_t n;

		(void)k_sem_take(&rx_sem, K_MSEC(CONFIG_SFS_DXL_POLL_MS));

		while ((n = ring_buf_get(&rx_ring, chunk, sizeof(chunk))) > 0U) {
			x430_bus_receive(&bus, chunk, n);
		}

		if (factory_baud_pending) {
			x430_bus_lock(&bus);
			factory_baud_pending = false;
			apply_factory_baud();
			x430_bus_unlock(&bus);
		}

		if (k_uptime_get() >= next_poll) {
			next_poll += CONFIG_SFS_DXL_POLL_MS;
			x430_bus_poll(&bus);
			x430_bus_lock(&bus);
			refresh_live();
			x430_bus_unlock(&bus);

			const atomic_val_t overruns = atomic_set(&rx_overruns, 0);

			if (overruns != 0) {
				LOG_WRN("RX ring buffer overrun (%ld)", (long)overruns);
			}
		}
	}
}

int dxl_bus_init(void)
{
	const struct x430_bus_config bus_cfg = {
		.write = uart_write,
		.write_context = NULL,
		.port = &port,
	};
	const struct x430_device_config dev_cfg = {
		.id = CONFIG_SFS_DXL_ID,
		.hooks = &hooks,
		.user_data = NULL,
	};
	int ret;

	if (!device_is_ready(uart)) {
		LOG_ERR("%s not ready", uart->name);
		return -ENODEV;
	}

	ret = nvm_init();
	if (ret != 0) {
		LOG_WRN("NVM unavailable (%d): EEPROM area not persistent", ret);
	}

	if ((x430_bus_init(&bus, &bus_cfg) != X430_OK) ||
	    (x430_device_init(&joint_dev, &dev_cfg) != X430_OK) ||
	    (x430_bus_attach(&bus, &joint_dev) != X430_OK)) {
		LOG_ERR("X430 initialisation failed");
		return -EINVAL;
	}

	x430_bus_lock(&bus);
	reload_cache();
	if (eeprom_missing && (cache.baud != CONFIG_SFS_DXL_FACTORY_BAUD_CODE)) {
		apply_factory_baud(); /* first start: this firmware's factory baud rate */
	}
	(void)uart_set_baud(cache.baud);
	refresh_live();
	x430_bus_unlock(&bus);

	uart_irq_callback_set(uart, uart_isr);
	uart_irq_rx_enable(uart);

	(void)k_thread_create(&dxl_thread, dxl_stack, K_THREAD_STACK_SIZEOF(dxl_stack),
			      dxl_thread_fn, NULL, NULL, NULL, CONFIG_SFS_DXL_THREAD_PRIORITY, 0,
			      K_NO_WAIT);
	(void)k_thread_name_set(&dxl_thread, "dxl");

	LOG_INF("DYNAMIXEL %s: ID %u, model %u, %s", CONFIG_X430_MODEL_NAME,
		x430_device_id(&joint_dev), (unsigned int)reg(X430_ADDR_MODEL_NUMBER),
		uart->name);
	return 0;
}
```

## src/motor.c
```c
/*
 * SPDX-License-Identifier: Apache-2.0
 *
 * Stepper-C integration (see motor.h). Execution model of the library
 * (sstep.h): sstep_fast_loop() in the PWM/ADC interrupt at the PWM rate,
 * sstep_slow_loop() and every command from one context at slow_loop_hz. Here
 * that context is the cooperative thread "motor"; it wakes on an absolute
 * tick schedule, so the period does not drift with the work done in it.
 */

#include "motor.h"

#include <errno.h>
#include <math.h>

#include <zephyr/kernel.h>
#include <zephyr/logging/log.h>
#include <zephyr/sys/atomic.h>

#include "power_stage.h"
#if defined(CONFIG_SFS_SIM_PLANT)
#include "sim_plant.h"
#endif

LOG_MODULE_REGISTER(motor, CONFIG_SFS_LOG_LEVEL);

#define SLOW_HZ CONFIG_SFS_CTRL_SLOW_LOOP_HZ

BUILD_ASSERT((CONFIG_SYS_CLOCK_TICKS_PER_SEC % SLOW_HZ) == 0,
	     "the system tick rate must be a multiple of the slow loop rate");

enum motor_op {
	OP_ENABLE,
	OP_DISABLE,
	OP_MOVE_TO,
	OP_RUN,
	OP_STOP,
	OP_SET_POSITION,
	OP_SET_CURRENT,
	OP_CLEAR_FAULTS,
};

struct motor_req {
	enum motor_op op;
	int32_t arg0;
	uint32_t arg1;
	uint32_t arg2;
	int result;
	struct k_sem done;
};

K_MSGQ_DEFINE(motor_queue, sizeof(struct motor_req *), 4, sizeof(void *));
K_MUTEX_DEFINE(motor_req_lock); /* one request in flight per caller set */

static struct sstep drv;
static struct k_spinlock snap_lock;
static struct motor_snapshot snap;
static atomic_t fault_flags; /* set by on_fault (possibly from the ISR) */

static K_THREAD_STACK_DEFINE(motor_stack, CONFIG_SFS_MOTOR_THREAD_STACK_SIZE);
static struct k_thread motor_thread;

/* ------------------------------------------------------------------------ */
/* Stepper-C callbacks                                                      */

static void on_fault(void *context, uint16_t faults)
{
	ARG_UNUSED(context);
	/* May run in the zero-latency interrupt: no kernel calls here. */
	(void)atomic_or(&fault_flags, (atomic_val_t)faults);
}

static void on_event(void *context, enum sstep_event event)
{
	ARG_UNUSED(context);
	if (event == SSTEP_EVENT_MOVE_DONE) {
		LOG_DBG("move done");
	}
}

static void fast_loop(const struct sstep_sample *sample, bool w_trip, void *ctx)
{
	struct sstep *const d = ctx;

	if (w_trip) {
		(void)sstep_report_fault(d, SSTEP_FAULT_EXTERNAL);
	}
	(void)sstep_fast_loop(d, sample);
}

/* ------------------------------------------------------------------------ */

static int build_config(struct sstep_config *cfg)
{
	const struct power_stage_info *ps = power_stage_get_info();

	if ((ps->pwm_freq_hz % SLOW_HZ) != 0U) {
		LOG_ERR("PWM %u Hz is not a multiple of the slow loop %u Hz", ps->pwm_freq_hz,
			SLOW_HZ);
		return -EINVAL;
	}

	*cfg = (struct sstep_config){
		.motor = {
			.r_mohm = CONFIG_SFS_MOTOR_R_MOHM,
			.l_uh = CONFIG_SFS_MOTOR_L_UH,
			.i_rated_ma = CONFIG_SFS_MOTOR_I_RATED_MA,
			.ke_uv_s_per_rad = CONFIG_SFS_MOTOR_KE_UV_S_PER_RAD,
			.full_steps_per_rev = CONFIG_SFS_MOTOR_FULL_STEPS_PER_REV,
		},
		.stage = {
			.topology = SSTEP_TOPOLOGY_SHARED_LEG,
			.vbus_nominal_mv = CONFIG_SFS_STAGE_VBUS_NOMINAL_MV,
			.vbus_min_mv = CONFIG_SFS_STAGE_VBUS_MIN_MV,
			.vbus_max_mv = CONFIG_SFS_STAGE_VBUS_MAX_MV,
			.i_full_scale_ma = ps->i_full_scale_ma,
			.i_trip_ma = CONFIG_SFS_STAGE_I_TRIP_MA,
			.pwm_period_ticks = ps->pwm_period_ticks,
			.pwm_freq_hz = ps->pwm_freq_hz,
			.dead_time_ns = ps->dead_time_ns,
			.adc_i_zero = ps->adc_i_zero,
			.adc_i_span = ps->adc_i_span,
			.adc_vbus_mv_full = ps->adc_vbus_mv_full,
			.adc_full = ps->adc_full,
		},
		.ctrl = {
			.drive_mode = IS_ENABLED(CONFIG_SFS_CTRL_VOLTAGE_DRIVE) ? SSTEP_DRIVE_VOLTAGE
										: SSTEP_DRIVE_CURRENT,
			/* one injected sequence per PWM period */
			.fast_loop_hz = ps->pwm_freq_hz,
			.slow_loop_hz = SLOW_HZ,
			.microsteps = CONFIG_SFS_CTRL_MICROSTEPS,
			.current_bw_hz = CONFIG_SFS_CTRL_CURRENT_BW_HZ,
			.i_run_ma = CONFIG_SFS_CTRL_I_RUN_MA,
			.i_hold_ma = CONFIG_SFS_CTRL_I_HOLD_MA,
			.hold_delay_ms = CONFIG_SFS_CTRL_HOLD_DELAY_MS,
			.v_max = CONFIG_SFS_CTRL_V_MAX,
			.accel = CONFIG_SFS_CTRL_ACCEL_MAX,
			.decel = 0U,
		},
		.hal = {
			.context = NULL,
			.pwm_write = power_stage_pwm_write,
			.output_enable = power_stage_output_enable,
			.on_fault = on_fault,
			.on_event = on_event,
		},
	};
	return 0;
}

static int sstep_to_errno(int rc)
{
	switch (rc) {
	case SSTEP_OK:
		return 0;
	case SSTEP_ERR_STATE:
		return -EBUSY;
	case SSTEP_ERR_UNSUPPORTED:
		return -ENOTSUP;
	default:
		return -EINVAL;
	}
}

/* Runs in the slow-loop thread. */
static int execute(struct motor_req *req)
{
	int rc;

	switch (req->op) {
	case OP_ENABLE:
		rc = sstep_enable(&drv);
		break;
	case OP_DISABLE:
		rc = sstep_disable(&drv);
		break;
	case OP_MOVE_TO:
		rc = sstep_set_motion_limits(&drv, req->arg1, req->arg2, 0U);
		if (rc == SSTEP_OK) {
			rc = sstep_move_to(&drv, req->arg0);
		}
		break;
	case OP_RUN:
		rc = sstep_set_motion_limits(&drv, req->arg1, req->arg2, 0U);
		if (rc == SSTEP_OK) {
			rc = sstep_run(&drv, req->arg0);
		}
		break;
	case OP_STOP:
		rc = sstep_stop(&drv);
		break;
	case OP_SET_POSITION: {
		struct sstep_status before;

		(void)sstep_get_status(&drv, &before);
		rc = sstep_set_position(&drv, req->arg0);
#if defined(CONFIG_SFS_SIM_PLANT)
		if (rc == SSTEP_OK) {
			/* the rotor stays where it is, only its coordinate changes */
			sim_plant_shift_position(req->arg0 - before.position);
		}
#endif
		break;
	}
	case OP_SET_CURRENT:
		rc = sstep_set_current(&drv, req->arg1, req->arg2);
		if (rc == SSTEP_OK) {
			k_spinlock_key_t key = k_spin_lock(&snap_lock);

			snap.i_run_ma = req->arg1;
			snap.i_hold_ma = req->arg2;
			k_spin_unlock(&snap_lock, key);
		}
		break;
	case OP_CLEAR_FAULTS:
		rc = sstep_clear_faults(&drv);
		(void)atomic_clear(&fault_flags);
		break;
	default:
		rc = SSTEP_ERR_PARAM;
		break;
	}
	return sstep_to_errno(rc);
}

static void publish(void)
{
	struct sstep_status status;
	k_spinlock_key_t key;

	if (sstep_get_status(&drv, &status) != SSTEP_OK) {
		return;
	}

	const float ia = (float)status.i_a_ma;
	const float ib = (float)status.i_b_ma;
	const uint32_t amplitude = (uint32_t)sqrtf((ia * ia) + (ib * ib));

	key = k_spin_lock(&snap_lock);
	snap.status = status;
	snap.i_amplitude_ma = amplitude;
	snap.sequence++;
	k_spin_unlock(&snap_lock, key);
}

static void motor_thread_fn(void *p1, void *p2, void *p3)
{
	const k_ticks_t period = CONFIG_SYS_CLOCK_TICKS_PER_SEC / SLOW_HZ;
	k_ticks_t next = k_uptime_ticks();
	uint16_t reported = 0U;

	ARG_UNUSED(p1);
	ARG_UNUSED(p2);
	ARG_UNUSED(p3);

	for (;;) {
		struct motor_req *req;

		next += period;
		(void)k_sleep(K_TIMEOUT_ABS_TICKS(next));

		(void)sstep_slow_loop(&drv);

		while (k_msgq_get(&motor_queue, &req, K_NO_WAIT) == 0) {
			req->result = execute(req);
			k_sem_give(&req->done);
		}

		publish();

		const uint16_t faults = (uint16_t)atomic_get(&fault_flags);

		if (faults != reported) {
			if (faults != 0U) {
				LOG_WRN("faults 0x%04x", faults);
			}
			reported = faults;
		}
	}
}

/* ------------------------------------------------------------------------ */

static int request(enum motor_op op, int32_t arg0, uint32_t arg1, uint32_t arg2)
{
	struct motor_req req = {.op = op, .arg0 = arg0, .arg1 = arg1, .arg2 = arg2};
	struct motor_req *ptr = &req;
	int ret;

	if (k_current_get() == &motor_thread) {
		return execute(&req);
	}

	k_sem_init(&req.done, 0, 1);
	(void)k_mutex_lock(&motor_req_lock, K_FOREVER);
	ret = k_msgq_put(&motor_queue, &ptr, K_MSEC(10));
	if (ret == 0) {
		/* the slow loop executes it within one period */
		ret = k_sem_take(&req.done, K_MSEC(50));
		if (ret == 0) {
			ret = req.result;
		} else {
			LOG_ERR("command %d not executed", op);
			/* req lives on this stack: wait until the thread is done with it */
			(void)k_sem_take(&req.done, K_FOREVER);
			ret = -ETIMEDOUT;
		}
	}
	k_mutex_unlock(&motor_req_lock);
	return ret;
}

int motor_init(void)
{
	struct sstep_config cfg;
	int ret;

	ret = build_config(&cfg);
	if (ret != 0) {
		return ret;
	}

	ret = sstep_init(&drv, &cfg);
	if (ret != SSTEP_OK) {
		LOG_ERR("sstep_init: %d", ret);
		return sstep_to_errno(ret);
	}

	snap.i_run_ma = cfg.ctrl.i_run_ma;
	snap.i_hold_ma = cfg.ctrl.i_hold_ma;
	publish();

	power_stage_set_w_trip(IS_ENABLED(CONFIG_SFS_STAGE_PHASE_W_TRIP) ? cfg.stage.i_trip_ma
									  : 0U);
	power_stage_set_fast_fn(fast_loop, &drv);

	(void)k_thread_create(&motor_thread, motor_stack, K_THREAD_STACK_SIZEOF(motor_stack),
			      motor_thread_fn, NULL, NULL, NULL, CONFIG_SFS_MOTOR_THREAD_PRIORITY,
			      K_FP_REGS, K_NO_WAIT);
	(void)k_thread_name_set(&motor_thread, "motor");

	LOG_INF("Stepper-C %s: %u microsteps, run %u mA, hold %u mA, %s drive", SSTEP_VERSION,
		cfg.ctrl.microsteps, cfg.ctrl.i_run_ma, cfg.ctrl.i_hold_ma,
		(cfg.ctrl.drive_mode == SSTEP_DRIVE_CURRENT) ? "current" : "voltage");
	return 0;
}

void motor_get_snapshot(struct motor_snapshot *snapshot)
{
	k_spinlock_key_t key = k_spin_lock(&snap_lock);

	*snapshot = snap;
	k_spin_unlock(&snap_lock, key);
}

bool motor_outputs_allowed(void)
{
	/* the simulated motor never enables the gate drivers */
	return IS_ENABLED(CONFIG_SFS_SIM_PLANT) || (power_stage_get_info()->dead_time_ns != 0U);
}

int motor_enable(bool enable)
{
	if (enable && !motor_outputs_allowed()) {
		LOG_ERR("enable refused: dead-time-ns of the power stage is not set");
		return -EPERM;
	}
	return request(enable ? OP_ENABLE : OP_DISABLE, 0, 0U, 0U);
}

int motor_move_to(int32_t target, uint32_t v_max, uint32_t accel)
{
	return request(OP_MOVE_TO, target, v_max, accel);
}

int motor_run(int32_t velocity, uint32_t v_max, uint32_t accel)
{
	return request(OP_RUN, velocity, v_max, accel);
}

int motor_stop(void)
{
	return request(OP_STOP, 0, 0U, 0U);
}

int motor_set_position(int32_t position)
{
	return request(OP_SET_POSITION, position, 0U, 0U);
}

int motor_set_current(uint32_t run_ma, uint32_t hold_ma)
{
	run_ma = MIN(run_ma, (uint32_t)CONFIG_SFS_CTRL_I_RUN_MA);
	hold_ma = MIN(MIN(hold_ma, (uint32_t)CONFIG_SFS_CTRL_I_HOLD_MA), run_ma);
	return request(OP_SET_CURRENT, 0, run_ma, hold_ma);
}

int motor_clear_faults(void)
{
	return request(OP_CLEAR_FAULTS, 0, 0U, 0U);
}
```

## src/motor.h
```c
/*
 * SPDX-License-Identifier: Apache-2.0
 *
 * Stepper-C driver instance: configuration from Kconfig and the power stage,
 * fast loop in the power-stage interrupt, slow loop in a cooperative thread.
 * Every Stepper-C command runs in the slow-loop thread; other threads call the
 * motor_*() functions below, which hand the command over and wait for it.
 */

#ifndef SFS_MOTOR_H
#define SFS_MOTOR_H

#include <stdbool.h>
#include <stdint.h>

#include <sstep.h>

#ifdef __cplusplus
extern "C" {
#endif

/** State published by the slow loop every period. */
struct motor_snapshot {
	struct sstep_status status; /**< sstep_get_status() of the last period. */
	uint32_t i_amplitude_ma;    /**< sqrt(iA^2 + iB^2) [mA]. */
	uint32_t i_run_ma;          /**< Active run current [mA]. */
	uint32_t i_hold_ma;         /**< Active hold current [mA]. */
	uint32_t sequence;          /**< Incremented every slow-loop period. */
};

/** Initialise Stepper-C and start the slow loop (power stage must be initialised). */
int motor_init(void);

/** Copy of the latest snapshot (any thread). */
void motor_get_snapshot(struct motor_snapshot *snapshot);

/** Enable (hold position) or disable (coast) the outputs. */
int motor_enable(bool enable);

/** Move to @p target [microsteps] with the given limits. */
int motor_move_to(int32_t target, uint32_t v_max, uint32_t accel);

/** Run at @p velocity [microsteps/s] with acceleration @p accel. */
int motor_run(int32_t velocity, uint32_t v_max, uint32_t accel);

/** Decelerate to standstill. */
int motor_stop(void);

/** Redefine the current position [microsteps] (standstill only). */
int motor_set_position(int32_t position);

/** Change run and hold currents [mA]; limited to the configured values. */
int motor_set_current(uint32_t run_ma, uint32_t hold_ma);

/** Clear the faults (driver goes to disabled). */
int motor_clear_faults(void);

/** true when the gate drivers may be enabled (dead time configured). */
bool motor_outputs_allowed(void);

#ifdef __cplusplus
}
#endif

#endif /* SFS_MOTOR_H */
```

## src/nvm.h
```c
/*
 * SPDX-License-Identifier: Apache-2.0
 *
 * Persistent blocks of the emulated DYNAMIXEL (EEPROM area, Control Table
 * backup) in the storage_partition, with Zephyr NVS. The X430 library adds
 * the header and the CRC; this layer stores opaque blocks by slot.
 */

#ifndef SFS_NVM_H
#define SFS_NVM_H

#include <stddef.h>
#include <stdint.h>

#ifdef __cplusplus
extern "C" {
#endif

/** Mount the NVS file system (no-op without CONFIG_SFS_DXL_NVM). */
int nvm_init(void);

/** Read block @p slot; 0 when exactly @p size bytes were read, negative otherwise. */
int nvm_load(uint8_t slot, uint8_t *data, size_t size);

/** Write block @p slot; 0 on success. */
int nvm_store(uint8_t slot, const uint8_t *data, size_t size);

#ifdef __cplusplus
}
#endif

#endif /* SFS_NVM_H */
```

## src/power_stage.h
```c
/*
 * SPDX-License-Identifier: Apache-2.0
 *
 * B-G431B-ESC1 power stage: TIM1 complementary center-aligned PWM on three
 * legs, OPAMP current amplifiers, ADC1/ADC2 injected conversions triggered by
 * TIM1 at the center of the PWM period, and the fast-loop interrupt.
 * Hardware description: the "sfs,stm32-shared-leg-power-stage" devicetree node.
 */

#ifndef SFS_POWER_STAGE_H
#define SFS_POWER_STAGE_H

#include <stdbool.h>
#include <stdint.h>

#include <sstep.h>

#ifdef __cplusplus
extern "C" {
#endif

/** Scaling of the power stage, in the units of struct sstep_stage_cfg. */
struct power_stage_info {
	uint32_t timer_clock_hz;   /**< TIM1 kernel clock [Hz]. */
	uint16_t pwm_period_ticks; /**< Compare value for 100 % duty (ARR). */
	uint32_t pwm_freq_hz;      /**< PWM frequency [Hz]. */
	uint32_t dead_time_ns;     /**< Dead time [ns] from the devicetree; 0 = not set. */
	uint32_t i_full_scale_ma;  /**< Phase current for |adc_i_span| counts [mA]. */
	int32_t adc_i_span;        /**< Counts from 0 A to +i_full_scale_ma (signed). */
	uint16_t adc_i_zero;       /**< Reading at 0 A after offset compensation. */
	uint32_t adc_vbus_mv_full; /**< Bus voltage at adc_full [mV]. */
	uint16_t adc_full;         /**< Largest ADC reading. */
};

/**
 * @brief Fast-loop callback, called from the zero-latency ADC interrupt at the
 *        PWM rate. Must not call kernel services.
 * @param sample  Phase currents (offset-compensated, zero at adc_i_zero) and bus voltage.
 * @param w_trip  true when |iW| of the shared leg exceeds the trip level.
 */
typedef void (*power_stage_fast_fn)(const struct sstep_sample *sample, bool w_trip, void *ctx);

/** Configure OPAMPs, TIM1 and the ADCs; PWM runs, outputs stay off. */
int power_stage_init(void);

/** Scaling values for sstep_init(); valid after power_stage_init(). */
const struct power_stage_info *power_stage_get_info(void);

/** Measure the current sensor offsets with the outputs off (blocks the caller). */
int power_stage_calibrate(uint32_t samples);

/** Install the fast-loop callback (NULL removes it). */
void power_stage_set_fast_fn(power_stage_fast_fn fn, void *ctx);

/** Overcurrent level of the shared leg check [mA]; 0 disables the check. */
void power_stage_set_w_trip(uint32_t trip_ma);

/** Stepper-C pwm_write callback: compare values of legs U, V, W. */
int power_stage_pwm_write(void *context, const uint16_t compare[SSTEP_LEGS_MAX]);

/** Stepper-C output_enable callback: TIM1 main output enable (MOE). */
int power_stage_output_enable(void *context, bool enable);

/** Number of fast-loop interrupts since start (for diagnostics). */
uint32_t power_stage_isr_count(void);

/** Longest fast-loop callback since the last reset [CPU cycles] (DWT counter). */
uint32_t power_stage_fast_cycles_max(bool reset);

#ifdef __cplusplus
}
#endif

#endif /* SFS_POWER_STAGE_H */
```

## src/sim_plant.h
```c
/*
 * SPDX-License-Identifier: Apache-2.0
 *
 * Simulated motor behind the power stage (CONFIG_SFS_SIM_PLANT): averaged
 * shared-leg power stage, two-phase hybrid stepper and current sensing, the
 * plant model of sfs-stepper-sim (sil/c/sstep_plant.c, west project). The power
 * stage calls it from the fast-loop interrupt in place of the ADC readings and
 * the gate drivers:
 *
 *   sim_plant_sample()      ADC counts of the state at the sampling instant
 *   fast loop (Stepper-C)   -> power_stage_pwm_write() -> sim_plant_set_compare()
 *   sim_plant_step()        integrate one PWM period with the voltage of the
 *                           previous compare values (one-period delay, as on
 *                           the hardware), then take the new ones
 */

#ifndef SFS_SIM_PLANT_H
#define SFS_SIM_PLANT_H

#include <stdbool.h>
#include <stdint.h>

#include <sstep.h>

#include "power_stage.h"

#ifdef __cplusplus
extern "C" {
#endif

/** State of the model, published every PWM period. */
struct sim_plant_state {
	int32_t i_a_ma;       /**< Phase A current [mA]. */
	int32_t i_b_ma;       /**< Phase B current [mA]. */
	int32_t v_a_mv;       /**< Phase A voltage applied in the last period [mV]. */
	int32_t v_b_mv;       /**< Phase B voltage applied in the last period [mV]. */
	int32_t speed_mrpm;   /**< Rotor speed [0.001 rpm]. */
	int32_t rotor_usteps; /**< Rotor position [microsteps], same zero as Stepper-C. */
	int32_t load_unm;     /**< Load torque [uN*m]. */
	bool enabled;         /**< Outputs enabled (windings driven). */
};

/** Set up the model with the scaling of the power stage; rotor at rest at angle 0. */
int sim_plant_init(const struct power_stage_info *info);

/** ADC sample of the present state and |iA + iB| of the shared leg [mA]. ISR. */
void sim_plant_sample(struct sstep_sample *sample, uint32_t *i_w_ma);

/** Compare values written by Stepper-C for the next period. ISR. */
void sim_plant_set_compare(const uint16_t compare[SSTEP_LEGS_MAX]);

/** Outputs on (windings driven) or off (windings open). Any context. */
void sim_plant_set_enabled(bool enable);

/** Advance the model by one PWM period. ISR, after the fast loop. */
void sim_plant_step(void);

/**
 * Load torque [uN*m], positive against forward motion, acting from the first
 * time the outputs are enabled (at power-on the joint rests on a support).
 * Any context.
 */
void sim_plant_set_load(int32_t load_unm);

/** Bus voltage of the model [mV] (CONFIG_SFS_SIM_VBUS_MV at start). Any context. */
void sim_plant_set_vbus(uint32_t vbus_mv);

/** Follow sstep_set_position(): shift the reported rotor position. Any context. */
void sim_plant_shift_position(int32_t delta_usteps);

/** Copy of the latest published state (thread context). */
void sim_plant_get_state(struct sim_plant_state *state);

#ifdef __cplusplus
}
#endif

#endif /* SFS_SIM_PLANT_H */
```
