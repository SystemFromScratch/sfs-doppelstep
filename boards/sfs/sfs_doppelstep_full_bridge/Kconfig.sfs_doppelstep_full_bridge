## dts/bindings/sfs/sfs,stm32-shared-leg-power-stage.yaml
```yaml
# SPDX-License-Identifier: Apache-2.0

description: |
  Three half-bridges driven by an STM32 advanced-control timer (TIM1) with
  complementary outputs, with low-side shunt current sensing through the
  internal OPAMPs and injected ADC conversions triggered by the timer.

  This backend programs TIM1, ADC1 and ADC2 directly (LL); the referenced
  timer and ADC nodes must therefore stay "disabled" so that no Zephyr driver
  claims them. The OPAMP nodes are "okay" and configured by the Zephyr OPAMP
  driver, the comparator and DAC nodes of the hardware trips are "okay" and
  configured by the Zephyr comparator and DAC drivers.

  Legs, in the order of Stepper-C's shared-leg topology:
    leg 0 = U = TIM1 CH1/CH1N, leg 1 = V = CH2/CH2N, leg 2 = W = CH3/CH3N
  Phase A of the stepper motor is connected between U and W, phase B
  between V and W.

compatible: "sfs,stm32-shared-leg-power-stage"

include: [base.yaml, pinctrl-device.yaml, power-stage-common.yaml]

properties:
  pinctrl-0:
    required: true

  pinctrl-names:
    required: true

  timer:
    type: phandle
    required: true
    description: Advanced-control timer node (st,stm32-timers), status "disabled".

  adc-master:
    type: phandle
    required: true
    description: |
      ADC that converts phase U current, bus voltage and phase W current and
      raises the end-of-sequence interrupt (status "disabled").

  adc-slave:
    type: phandle
    required: true
    description: ADC that converts phase V current (status "disabled").

  opamps:
    type: phandles
    required: true
    description: Current amplifiers of phases U, V and W.

  opamp-gain:
    type: string
    required: true
    enum: ["OPAMP_GAIN_15", "OPAMP_GAIN_16"]
    description: PGA gain applied with opamp_set_gain() to every OPAMP.

  pwm-frequency:
    required: true

  dead-time-ns:
    type: int
    required: true
    description: |
      Dead time inserted by the timer [ns]. 0 means "not set": the
      driver then refuses to enable the outputs.

  phase-u-channel:
    type: int
    required: true
    description: adc-master channel of the phase U current amplifier output.

  phase-v-channel:
    type: int
    required: true
    description: adc-slave channel of the phase V current amplifier output.

  phase-w-channel:
    type: int
    required: true
    description: adc-master channel of the phase W current amplifier output.

  vbus-channel:
    type: int
    required: true
    description: adc-master channel of the bus voltage divider.

  temperature-channel:
    type: int
    description: |
      adc-master channel of the NTC divider (power stage temperature); none = no
      sensor, power_stage_get_temperature() then returns -ENOSYS. The divider is
      the NTC from the ADC reference to the input and ntc-bottom-ohm from the
      input to ground. Converted every PWM period, as the fourth injected rank.

  ntc-r25-ohm:
    type: int
    description: NTC resistance at 25 degC [Ohm]. Required with temperature-channel.

  ntc-beta:
    type: int
    description: |
      B constant of the NTC [K], for the range of interest (B25/85 for a trip
      level near 80 degC). Required with temperature-channel.

  ntc-bottom-ohm:
    type: int
    description: Fixed resistor from the ADC input to ground [Ohm]. Required with temperature-channel.

  sample-window-ns:
    type: int
    default: 0
    description: |
      Time around the top of the counter that every leg spends on its low-side
      switch at least [ns], so that the shunt samples see the phase currents and
      no switching edge: dead time, settling of the amplifier, and the sampling
      phases of the injected conversions. Stepper-C keeps every compare value at
      or below the period minus this time and lowers its voltage limit by the
      same fraction (sample_window_ticks). At most a quarter of the period.

  hw-trip-current-milliamp:
    type: int
    description: |
      Short-circuit level of the hardware trip [mA]; none = no hardware trip.
      The comparators of hw-trip-current-comparators compare the non-inverting
      inputs of the current amplifiers (shunt voltage on the bias of the board)
      with DAC levels and drive the break input BRK of the timer: the outputs go
      off in hardware, within the break filter (about 0.5 us). Catches a current
      down through a low-side switch: shoot-through, a phase shorted to the bus,
      a phase-to-phase short. The level follows the calibrated offset. Set it
      above trip-current-milliamp of the motor node.

  hw-trip-current-comparators:
    type: phandles
    description: |
      Comparators (st,stm32g4-comp, status "okay", driven by the Zephyr
      comparator driver) of the legs U, V and W, required with
      hw-trip-current-milliamp. The positive input of each one is the
      non-inverting input of the amplifier of its leg, the negative input a DAC
      channel (for example "DAC3_CH1"), whose DAC node must be "okay" too:
      the backend writes the level there with the Zephyr DAC driver. Legs that
      share a DAC channel get the highest of their levels.

  hw-trip-current-input-gain-milli:
    type: int
    description: |
      Gain from the comparator input (the non-inverting input of the current
      amplifier) to the ADC input, x1000. Default: the PGA gain of opamp-gain.
      Needed for an external feedback network.

  hw-trip-vbus-mv:
    type: int
    description: |
      Bus overvoltage level of the hardware trip [mV]; none = no hardware trip.
      The comparator of hw-trip-vbus-comparator compares the bus divider with a
      DAC level and drives the break input BRK2 of the timer. Set it above
      vbus-max-mv of the motor node.

  hw-trip-vbus-comparator:
    type: phandle
    description: |
      Comparator of the bus divider (as hw-trip-current-comparators), required
      with hw-trip-vbus-mv.

  current-offset-min-counts:
    type: int
    description: |
      Lowest acceptable current sensor offset at 0 A [ADC counts]. Outside
      [min, max], power_stage_calibrate() fails with -EIO and the outputs are
      refused: amplifier, shunt or bias network broken. None = no check.

  current-offset-max-counts:
    type: int
    description: Highest acceptable current sensor offset at 0 A [ADC counts].

  adc-vref-mv:
    required: true

  shunt-micro-ohms:
    required: true

  current-sense-gain-milli:
    required: true

  vbus-divider:
    required: true
```

## dts/bindings/sfs/sfs,ws2812-stm32-tim.yaml
```yaml
# SPDX-License-Identifier: Apache-2.0

description: |
  WS2812 LED chain on one channel of an STM32 general-purpose timer, the bits
  written to the compare register by DMA on every update event (one PWM period
  of 1.25 us per bit). Flash cost about 1.3 KB together with the led_strip code
  and the STATUS LED module: no Zephyr DMA or async UART driver, which together
  cost about 10 KB (docs/hardware-full-bridge.md).

  The driver programs the timer, one DMA1 channel and its DMAMUX channel
  directly (LL): the timer, dma1 and dmamux1 nodes must stay "disabled" so that
  no Zephyr driver claims them. The dmas property only names the DMAMUX channel
  and the request (cells: channel, request, configuration; the configuration is
  ignored), DMA1 channel = DMAMUX channel + 1.

compatible: "sfs,ws2812-stm32-tim"

include: [ws2812.yaml, pinctrl-device.yaml]

properties:
  pinctrl-0:
    required: true

  pinctrl-names:
    required: true

  timer:
    type: phandle
    required: true
    description: General-purpose timer node (st,stm32-timers), status "disabled".

  channel:
    type: int
    required: true
    enum: [1, 2, 3, 4]
    description: Timer channel of the data pin.

  dmas:
    type: phandle-array
    required: true
    description: |
      <&dmamux1 channel request 0>: request = the update event of the timer
      (TIM2_UP = 60 on the STM32G4).

  t0h-ns:
    type: int
    default: 400
    description: High time of a 0 bit [ns].

  t1h-ns:
    type: int
    default: 800
    description: High time of a 1 bit [ns].

  period-ns:
    type: int
    default: 1250
    description: Duration of one bit [ns].
```

## tests/drivers/common/dts/bindings/sfs/sfs,fake-power-stage.yaml
```yaml
# SPDX-License-Identifier: Apache-2.0

description: Fake power stage for driver tests.

compatible: "sfs,fake-power-stage"

include: base.yaml

properties:
  minimal:
    type: boolean
    description: Leave out the optional operations of the class.

  full-bridge:
    type: boolean
    description: |
      Two full H-bridges (4 legs, Stepper-C full-bridge topology) instead of
      three half-bridges with a shared leg.
```

## tests/drivers/ma730/testcase.yaml
```yaml
# SPDX-License-Identifier: Apache-2.0

tests:
  doppelstep.drivers.ma730:
    platform_allow: native_sim/native/64
    integration_platforms:
      - native_sim/native/64
    tags: doppelstep
```

## tests/drivers/sstep_motor/testcase.yaml
```yaml
# SPDX-License-Identifier: Apache-2.0

common:
  platform_allow: native_sim/native/64
  integration_platforms:
    - native_sim/native/64
  tags: doppelstep

tests:
  doppelstep.drivers.sstep_motor: {}
  doppelstep.drivers.sstep_motor.selftest:
    extra_configs:
      - CONFIG_SSTEP_MOTOR_SELFTEST=y
  doppelstep.drivers.sstep_motor.mcuviewer:
    extra_configs:
      - CONFIG_SSTEP_MOTOR_MCUVIEWER=y
  doppelstep.drivers.sstep_motor.deadtime:
    extra_args:
      - EXTRA_DTC_OVERLAY_FILE=deadtime.overlay
  doppelstep.drivers.sstep_motor.full_bridge:
    extra_args:
      - EXTRA_DTC_OVERLAY_FILE=full_bridge.overlay
  doppelstep.drivers.sstep_motor.full_bridge.selftest:
    extra_configs:
      - CONFIG_SSTEP_MOTOR_SELFTEST=y
    extra_args:
      - EXTRA_DTC_OVERLAY_FILE=full_bridge.overlay
```

## tests/drivers/ws2812/testcase.yaml
```yaml
# SPDX-License-Identifier: Apache-2.0

tests:
  doppelstep.drivers.ws2812:
    platform_allow: native_sim/native/64
    integration_platforms:
      - native_sim/native/64
    tags: doppelstep
```
